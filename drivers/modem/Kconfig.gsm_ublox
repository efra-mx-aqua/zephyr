## drivers/modem/Kconfig.gsm_ublox
```kconfig
# © 2022 Aqua Robur AB
#
# SPDX-License-Identifier: Apache-2.0

config MODEM_GSM_UBLOX_EXTENSIONS
       bool "Enable Ublox modem extensions for gsm_ppp"

if MODEM_GSM_UBLOX_EXTENSIONS

config MODEM_GSM_MNOPROF
       int "MNO profile for the network connection"
       default 100
       help
         This setting is used in the AT+UMNOPROF command to set the MNO
         profile for the network connection.  This value is specific to
         the network provider and must be changed.

config MODEM_GSM_CONFIGURE_RAT
       bool "Enable support for selecting RATs"
       default y
       help
         Choose this setting to select the Radio Access Technologies used.

config MODEM_GSM_CONFIGURE_RAT1
       bool "Enable support for selecting RATs"
       default y
       depends on MODEM_GSM_CONFIGURE_RAT
       help
         Choose this setting to select the Radio Access Technologies used.

config MODEM_GSM_CONFIGURE_RAT2
       bool "Enable support for selecting RATs"
       default n
       depends on MODEM_GSM_CONFIGURE_RAT && MODEM_GSM_CONFIGURE_RAT1
       help
         Choose this setting to select the Radio Access Technologies used.

if MODEM_GSM_CONFIGURE_RAT

config MODEM_GSM_RAT
       string "Radio Access Technologies (RATs)"
       default "8"
       help
         This setting is used to change the RATs that the modem will use
         to connect to the network
         (legacy, use MODEM_GSM_RAT1, MODEM_GSM_RAT2 and/or MODEM_GSM_RAT3)

config MODEM_GSM_RAT1
       int "Radio Access Technology (RAT) 1"
       default 8
       depends on MODEM_GSM_CONFIGURE_RAT1
       help
         This setting is used to change the RAT 1 that the modem will use
         to connect to the network.
         This is not meant to be upstreamed as-is!
         (3: LTE, 7: LTE Cat M1, 8: LTE Cat NB1, 9: GPRS / eGPRS)

config MODEM_GSM_RAT2
       int "Radio Access Technology (RAT) 2"
       default 8
       depends on MODEM_GSM_CONFIGURE_RAT2
       help
         This setting is used to change the RAT 2 that the modem will use
         to connect to the network.
         This is not meant to be upstreamed as-is!
	 (3: LTE, 7: LTE Cat M1, 8: LTE Cat NB1, 9: GPRS / eGPRS)

endif # MODEM_GSM_CONFIGURE_RAT

config MODEM_GSM_CONFIGURE_BAND_MASK
       bool "Enable support for selecting band masks"
       help
         Choose this setting to select the band masks for each RAT.

if MODEM_GSM_CONFIGURE_BAND_MASK

config MODEM_GSM_CONFIGURE_BAND_MASK_LTE
       bool "Enable support for selecting LTE Cat M1 band masks"
       help
         Choose this setting to select the band masks for each RAT.

config MODEM_GSM_CONFIGURE_BAND_MASK_NB
       bool "Enable support for selecting NB-IoT band masks"
       depends on MODEM_GSM_CONFIGURE_BAND_MASK
       help
         Choose this setting to select the band masks for each RAT.

config MODEM_GSM_BAND_MASK_LTE_0
       int "Band mask for LTE-Cat-M1 1"
       default 526494
       depends on MODEM_GSM_CONFIGURE_BAND_MASK_LTE
       help
         This setting is used to change the band mask for LTE-M1. It
         is a bitmask where bit 0 is band 1, etc.

config MODEM_GSM_BAND_MASK_LTE_1
       int "Band mask for LTE-Cat-M1 0"
       default 0
       depends on MODEM_GSM_CONFIGURE_BAND_MASK_LTE
       help
         This setting is used to change the band mask for LTE-M1. It
         is a bitmask where bit 0 is band 1, etc.

config MODEM_GSM_BAND_MASK_NB_0
       int "Band mask for LTE-NB 0"
       default 526494
       depends on MODEM_GSM_CONFIGURE_BAND_MASK_NB
       help
         This setting is used to change the band mask forLTE-NB-IoT 0. It
         is a bitmask where bit 0 is band 1, etc.

config MODEM_GSM_BAND_MASK_NB_1
       int "Bandmask for LTE-NB-IoT 1"
       default 0
       depends on MODEM_GSM_CONFIGURE_BAND_MASK_NB
       help
         This setting is used to change the band mask for LTE-NB-IoT 1. It
         is a bitmask where bit 0 is band 1, etc.

endif # MODEM_GSM_CONFIGURE_BAND_MASK

endif # MODEM_GSM_UBLOX_EXTENSIONS
```

## drivers/modem/Kconfig.ublox_ppp
```kconfig
# © 2020 Endian Technologies AB
#
# SPDX-License-Identifier: Apache-2.0

config UBLOX_PPP_EXTENSIONS
       bool "Enable Ublox modem extensions for gsm_ppp"

if UBLOX_PPP_EXTENSIONS

config MODEM_GSM_MNOPROF
       int "MNO profile for the network connection"
       default 100
       help
         This setting is used in the AT+UMNOPROF command to set the MNO
         profile for the network connection.  This value is specific to
         the network provider and must be changed.

config MODEM_GSM_CONFIGURE_URAT
       bool "Enable support for selecting RATs"
       default y
       help
         Choose this setting to select the Radio Access Technologies used.

if MODEM_GSM_CONFIGURE_URAT

config MODEM_GSM_URAT
       string "Radio Access Technologies (RATs)"
       default "8"
       help
         This setting is used to change the RATs that the modem will use
         to connect to the network
         This is not meant to be upstreamed as-is!

endif # MODEM_GSM_CONFIGURE_URAT

config MODEM_GSM_CONFIGURE_UBANDMASK
       default y
       bool "Enable support for selecting band masks"
       help
         Choose this setting to select the band masks for each RAT.

if MODEM_GSM_CONFIGURE_UBANDMASK

config MODEM_GSM_UBANDMASK_M1
       int "Bandmask for LTE-M1"
       default 526494
       help
         This setting is used to change the band mask for LTE-M1. It
         is a bitmask where bit 0 is band 1, etc.
         This is not meant to be upstreamed as-is!

config MODEM_GSM_UBANDMASK_NB1
       int "Bandmask for LTE-NB1"
       default 526494
       help
         This setting is used to change the band mask for LTE-NB1. It
         is a bitmask where bit 0 is band 1, etc.
         This is not meant to be upstreamed as-is!

config MODEM_GSM_UBLOX_PWR_INIT_PRIORITY
	int "Init priority for the GSM modem driver"
	default 41
	range 0 99
	help
	  The Ublox GSM modem is powered in POST_KERNEL using priority in
	  the range 0-99.

endif # MODEM_GSM_CONFIGURE_UBANDMASK

endif # UBLOX_PPP_EXTENSIONS
```

## drivers/modem/Kconfig.ublox_pwr
```kconfig
# © 2022 Aquarobur Technologies AB
#
# SPDX-License-Identifier: Apache-2.0

config MODEM_UBLOX_PWR
       bool "Enable Ublox modem power for gsm_ppp"
       default y if MODEM && !MODEM_UBLOX_SARA


config MODEM_UBLOX_PWR_INIT_PRIORITY
	int "Init priority for the GSM modem power driver"
	default 41
	range 0 99
	depends on MODEM_UBLOX_PWR
	help
	  The Ublox GSM modem is powered in POST_KERNEL using priority in
	  the range 0-99.
```

## dts/bindings/modem/u-blox,sara-r4.yaml
```yaml
# Copyright (c) 2019, Foundries.io
# SPDX-License-Identifier: Apache-2.0

description: u-blox SARA-R4 modem

compatible: "u-blox,sara-r4"

include: uart-device.yaml

properties:
    label:
      required: true

    mdm-power-gpios:
      type: phandle-array
      required: false

    mdm-pwr-on-gpios:
      type: phandle-array
      required: false

    mdm-reset-gpios:
      type: phandle-array
      required: false

    mdm-vint-gpios:
      type: phandle-array
      required: false

    mdm-dtr-gpios:
      type: phandle-array
      required: false
```

## modules/Kconfig.tinycbor
```kconfig
# Copyright (c) 2018 Intel Corporation
# SPDX-License-Identifier: Apache-2.0

config TINYCBOR
	bool "tinyCBOR Support"
	help
	  This option enables the tinyCBOR library.

if TINYCBOR

config CBOR_ENCODER_NO_CHECK_USER
	bool "No encoder checks for user args for validity"
	help
	  This option specifies whether a check user exists for a cbor encoder.

config CBOR_PARSER_MAX_RECURSIONS
	int "Parser max recursions"
	default 1024
	help
	  This option specifies max recursions for the parser.

config CBOR_PARSER_NO_STRICT_CHECKS
	bool "No strict parser checks"
	help
	  This option enables the strict parser checks.

config CBOR_FLOATING_POINT
	bool "Floating point support"
	select REQUIRES_FULL_LIBC
	help
	  This option enables floating point support.

config CBOR_HALF_FLOAT_TYPE
	bool "Half float type support"
	select REQUIRES_FULL_LIBC
	help
	  This option enables half float type support.

config CBOR_WITHOUT_OPEN_MEMSTREAM
	bool "Without open memstream"
	default y
	help
	  This option enables open memstream support.

config CBOR_PRETTY_PRINTING
	bool "Implement pretty printing functionality"
	select CBOR_PARSER_DUP_STRING
	help
	  This option enables cbor_value_to_pretty_stream function.

config CBOR_PARSER_DUP_STRING
	bool "Implement parser's string duplication functionality"
	default y if NEWLIB_LIBC
	help
	  This option enables cbor_value_copy_text_string,
	  cbor_value_dup_byte_string, cbor_value_dup_text_string functions.

endif # TINYCBOR
```
